## sdkconfig.defaults
```kconfig
CONFIG_IDF_TARGET="esp32s3"

CONFIG_ESPTOOLPY_FLASHSIZE_16MB=y
CONFIG_ESPTOOLPY_FLASHSIZE="16MB"
CONFIG_PARTITION_TABLE_SINGLE_APP_LARGE=y

CONFIG_SPIRAM=y
CONFIG_SPIRAM_MODE_OCT=y
CONFIG_SPIRAM_TYPE_AUTO=y
CONFIG_SPIRAM_SPEED_80M=y
CONFIG_SPIRAM_USE_MALLOC=y

CONFIG_ESP_DEFAULT_CPU_FREQ_MHZ_240=y

CONFIG_FREERTOS_HZ=1000

CONFIG_COMPILER_OPTIMIZATION_PERF=y

CONFIG_LOG_DEFAULT_LEVEL_INFO=y

# LVGL v8.x configuration (RGB565 color buffer; flush packs to ST7305 2x2 layout)
CONFIG_LV_COLOR_DEPTH_16=y
CONFIG_LV_MEM_SIZE_KILOBYTES=64
CONFIG_LV_DISP_DEF_REFR_PERIOD=1
CONFIG_LV_INDEV_DEF_READ_PERIOD=50
CONFIG_LV_USE_SNAPSHOT=n
```
